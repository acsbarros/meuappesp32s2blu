## main/Kconfig.projbuild
```kconfig
menu "Menu Personalizado"
    config NOME_DO_PROJETO
        string "Nome do Projeto"
        default "Meu projeto APS"
        help
            Preencha o nome do projeto

    choice MY_CHOICE
        prompt "Selecionar uma opcao"
        default DEBUG

        config DEBUG
            bool "Habilitar o modo DEBUG"

        config HOMOLOGACAO
            bool "Habilitar o modo homologacao"

        config PRODUCAO
            bool "Habilitar o modo PRODUCAO"
    endchoice

    config FREQUENCIA_DE_ATUALIZACAO
        int "valor inteiro"
        range 1 30
endmenu
```

## sdkconfig.defaults
```kconfig
CONFIG_IDF_TARGET="esp32s2"
CONFIG_ESP_CONSOLE_USB_CDC=y
CONFIG_CONSOLE_UART_NUM=-1
CONFIG_BOOTLOADER_LOG_LEVEL_WARN=y
CONFIG_BOOTLOADER_LOG_LEVEL=2
CONFIG_DEBUG=y
CONFIG_FREQUENCIA_DE_INICIALIZACAO=5
CONFIG_NOME_DO_PROJETO = "Projeto do Carlos"
```
